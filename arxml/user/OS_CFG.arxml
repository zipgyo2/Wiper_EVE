AUTOSAR XML (schema 4-0-3)
package /OS_CFG
  module config Os_0: definition=Os
    4 x OsTask, all with OsTaskActivation=1:
      OsTask_0: OsTaskPriority=1
      OsTask_1: OsTaskPriority=2
      OsTask_2: OsTaskPriority=3
      OsTask_3: OsTaskPriority=4
