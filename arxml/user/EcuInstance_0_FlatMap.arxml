AUTOSAR XML (schema 4-0-3)
package /EcuInstance_0_FlatView
  flat map EcuInstance_0_FlatMap
    9 x flat instance descriptor:
      CPT_ECU_ABS: upstream-reference=RootSwCompositionPrototype_0.CPT_ECU_ABS, ecu-extract-reference=CPT_EcuInstance_0_FlatView.CPT_ECU_ABS
      CPT_Rain_Sensor: upstream-reference=RootSwCompositionPrototype_0.CPT_Rain_Sensor, ecu-extract-reference=CPT_EcuInstance_0_FlatView.CPT_Rain_Sensor
      CPT_Switch_Sensor: upstream-reference=RootSwCompositionPrototype_0.CPT_Switch_Sensor, ecu-extract-reference=CPT_EcuInstance_0_FlatView.CPT_Switch_Sensor
      switch_sensor_value: upstream-reference=RootSwCompositionPrototype_0.CPT_Switch_Sensor.Pport_SwitchSensor_to_WiperMode.switch_sensor_value, ecu-extract-reference=CPT_EcuInstance_0_FlatView.CPT_Switch_Sensor.Pport_SwitchSensor_to_WiperMode.switch_sensor_value
      CPT_Wiper_Controller: upstream-reference=RootSwCompositionPrototype_0.CPT_Wiper_Controller, ecu-extract-reference=CPT_EcuInstance_0_FlatView.CPT_Wiper_Controller
      CPT_Wiper_Motor: upstream-reference=RootSwCompositionPrototype_0.CPT_Wiper_Motor, ecu-extract-reference=CPT_EcuInstance_0_FlatView.CPT_Wiper_Motor
      wipermotor_Speed_Value_RPort: upstream-reference=RootSwCompositionPrototype_0.CPT_Wiper_Motor.Rport_WiperController_to_WiperMotor.wipermotor_Speed_Value, ecu-extract-reference=CPT_EcuInstance_0_FlatView.CPT_Wiper_Motor.Rport_WiperController_to_WiperMotor.wipermotor_Speed_Value
      CPT_Wiper_Motor_0: upstream-reference=RootSwCompositionPrototype_0.CPT_Wiper_Motor_0, ecu-extract-reference=CPT_EcuInstance_0_FlatView.CPT_Wiper_Motor_0
      wipermotor_Speed_Value_0_RPort: upstream-reference=RootSwCompositionPrototype_0.CPT_Wiper_Motor_0.Rport_WiperController_to_WiperMotor.wipermotor_Speed_Value, ecu-extract-reference=CPT_EcuInstance_0_FlatView.CPT_Wiper_Motor_0.Rport_WiperController_to_WiperMotor.wipermotor_Speed_Value
