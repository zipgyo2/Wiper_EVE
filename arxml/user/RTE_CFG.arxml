AUTOSAR XML (schema 4-0-3)
package /RTE_CFG
  module config Rte_0: definition=Rte
    CPT_Switch_Sensor (RteSwComponentInstance): RteSoftwareComponentInstanceRef=CPT_Switch_Sensor
      TE_100ms (RteEventToTaskMapping): RtePositionInTask=1, RteActivationOffset=0.0, RteMappedToTaskRef=OsTask_0, RteEventRef=TE_100ms
    RteGeneration_0 (RteGeneration):
      RteGenerationMode = VENDOR_MODE
      RteCalibrationSupport = NONE
      RteDevErrorDetect = 0
      RteDevErrorDetectUninit = 0
      RteIocInteractionReturnValue = RTE_COM
      RteMeasurementSupport = 1
      RteOptimizationMode = RUNTIME
      RteToolChainSignificantCharacters = 127
      RteVfbTraceEnabled = 0
    3 x RteSwComponentInstance:
      CPT_Wiper_Controller: RteSoftwareComponentInstanceRef=CPT_Wiper_Controller
        TE_100ms (RteEventToTaskMapping): RtePositionInTask=1, RteActivationOffset=0.0, RteMappedToTaskRef=OsTask_1, RteEventRef=TE_100ms
      CPT_Wiper_Motor_0: RteSoftwareComponentInstanceRef=CPT_Wiper_Motor_0
        DataReceivedEvent_0 (RteEventToTaskMapping): RtePositionInTask=1, RteActivationOffset=0.0, RteMappedToTaskRef=OsTask_2, RteEventRef=DataReceivedEvent_0
      CPT_Wiper_Motor: RteSoftwareComponentInstanceRef=CPT_Wiper_Motor
        DataReceivedEvent_0 (RteEventToTaskMapping): RtePositionInTask=1, RteActivationOffset=0.0, RteMappedToTaskRef=OsTask_3, RteEventRef=DataReceivedEvent_0
