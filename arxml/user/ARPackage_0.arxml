AUTOSAR XML (schema 4-0-3)
package /ARPackage_0
  system System_0: category=SYSTEM_EXTRACT
    system mapping SystemMapping_0
      sw-mappings:
        swc to ecu mapping SwcToEcuMapping_0: ecu-instance=EcuInstance_0
          component:
            RootSwCompositionPrototype_0.CPT_ECU_ABS
            RootSwCompositionPrototype_0.CPT_Rain_Sensor
            RootSwCompositionPrototype_0.CPT_Switch_Sensor
            RootSwCompositionPrototype_0.CPT_Wiper_Controller
            RootSwCompositionPrototype_0.CPT_Wiper_Motor
            RootSwCompositionPrototype_0.CPT_Wiper_Motor_0
    root-software-compositions:
      root sw composition prototype RootSwCompositionPrototype_0: software-composition=temp
  ecu instance EcuInstance_0
