AUTOSAR XML (schema 4-0-2)
standard types defined: uint8, Std_ReturnType
package /AUTOSAR_Rte/BswModuleDescriptions
  bsw module description RteBswModuleDescription: provided-entrys=[Rte_Start, Rte_Stop, SchM_DeInit, SchM_Init]
    bsw module dependency ModDepOS: target-module-id=001
      required-entrys:
        ActivateTask
        CancelAlarm
        ClearEvent
        GetEvent
        GetResource
        GetTaskID
        ReleaseResource
        ResumeOSInterrupts
        SetEvent
        SetRelAlarm
        SuspendOSInterrupts
        TerminateTask
        WaitEvent
    bsw internal behavior RteInternalBehavior
      constant-memorys:
        13 x parameter data prototype:
          Rte_Inst_ECU_ABS: type=Rte_CDS_ECU_ABS
          Rte_Inst_Rain_Sensor: type=Rte_CDS_Rain_Sensor
          Rte_Inst_Switch_Sensor: type=Rte_CDS_Switch_Sensor
          Rte_Inst_Wiper_Controller: type=Rte_CDS_Wiper_Controller
          Rte_Instance_CPT_Wiper_Motor: type=Rte_CDS_Wiper_Motor
          Rte_Instance_CPT_Wiper_Motor_0: type=Rte_CDS_Wiper_Motor
          Rte_Self_CPT_ECU_ABS: type=Rte_SelfType_ECU_ABS
          Rte_Self_CPT_Rain_Sensor: type=Rte_SelfType_Rain_Sensor
          Rte_Self_CPT_Switch_Sensor: type=Rte_SelfType_Switch_Sensor
          Rte_Self_CPT_Wiper_Controller: type=Rte_SelfType_Wiper_Controller
          Rte_Self_CPT_Wiper_Motor: type=Rte_SelfType_Wiper_Motor
          Rte_Self_CPT_Wiper_Motor_0: type=Rte_SelfType_Wiper_Motor
          Rte_Tasks: type=Rte_TaskInfo
      static-memorys:
        5 x data:
          Rte_ActCount_CPT_Wiper_Motor_0_DataReceivedEvent_0: type=Rte_REActCounterType
          Rte_ActCount_CPT_Wiper_Motor_DataReceivedEvent_0: type=Rte_REActCounterType
          switch_sensor_value: type=uint8
          wipermotor_Speed_Value_0_RPort: type=uint8
          wipermotor_Speed_Value_RPort: type=uint8
      4 x bsw called entity:
        BCERte_Start: implemented-entry=Rte_Start
        BCERte_Stop: implemented-entry=Rte_Stop
        BCESchM_DeInit: implemented-entry=SchM_DeInit
        BCESchM_Init: implemented-entry=SchM_Init
package /AUTOSAR_Rte/BswModuleEntrys
  4 x bsw module entry:
    Rte_Start
    Rte_Stop
    SchM_DeInit
    SchM_Init
package /AUTOSAR_Rte/BswImplementations
  bsw implementation Rte: programming-language=C, sw-version=0.0.0, used-code-generator=ETAS RTEGen, ar-release-version=4.0.0, behavior=RteInternalBehavior
    generated-artifacts:
      44 x dependency on artifact:
        Com_h: artifact-descriptor={short-label=Com_h, category=SWHDR, domain=AUTOSAR}
        ECU_ABS_MemMap_h: artifact-descriptor={short-label=ECU_ABS_MemMap_h, category=SWHDR, domain=AUTOSAR}
        Ioc_h: artifact-descriptor={short-label=Ioc_h, category=SWHDR, domain=AUTOSAR}
        MemMap_h: artifact-descriptor={short-label=MemMap_h, category=SWHDR, domain=AUTOSAR}
        NvM_h: artifact-descriptor={short-label=NvM_h, category=SWHDR, domain=AUTOSAR}
        Os_h: artifact-descriptor={short-label=Os_h, category=SWHDR, domain=AUTOSAR}
        OsTask_0_c: artifact-descriptor={short-label=OsTask_0_c, category=SWSRC, domain=AUTOSAR}
        OsTask_0_h: artifact-descriptor={short-label=OsTask_0_h, category=SWHDR, domain=AUTOSAR}
        OsTask_1_c: artifact-descriptor={short-label=OsTask_1_c, category=SWSRC, domain=AUTOSAR}
        OsTask_1_h: artifact-descriptor={short-label=OsTask_1_h, category=SWHDR, domain=AUTOSAR}
        OsTask_2_c: artifact-descriptor={short-label=OsTask_2_c, category=SWSRC, domain=AUTOSAR}
        OsTask_2_h: artifact-descriptor={short-label=OsTask_2_h, category=SWHDR, domain=AUTOSAR}
        OsTask_3_c: artifact-descriptor={short-label=OsTask_3_c, category=SWSRC, domain=AUTOSAR}
        OsTask_3_h: artifact-descriptor={short-label=OsTask_3_h, category=SWHDR, domain=AUTOSAR}
        Rain_Sensor_MemMap_h: artifact-descriptor={short-label=Rain_Sensor_MemMap_h, category=SWHDR, domain=AUTOSAR}
        Rte_c: artifact-descriptor={short-label=Rte_c, category=SWSRC, domain=AUTOSAR}
        Rte_h: artifact-descriptor={short-label=Rte_h, category=SWHDR, domain=AUTOSAR}
        Rte_Cbk_h: artifact-descriptor={short-label=Rte_Cbk_h, category=SWHDR, domain=AUTOSAR}
        Rte_Cfg_h: artifact-descriptor={short-label=Rte_Cfg_h, category=SWHDR, domain=AUTOSAR}
        Rte_Const_h: artifact-descriptor={short-label=Rte_Const_h, category=SWHDR, domain=AUTOSAR}
        Rte_DataHandleType_h: artifact-descriptor={short-label=Rte_DataHandleType_h, category=SWHDR, domain=AUTOSAR}
        Rte_ECU_ABS_c: artifact-descriptor={short-label=Rte_ECU_ABS_c, category=SWSRC, domain=AUTOSAR}
        Rte_ECU_ABS_h: artifact-descriptor={short-label=Rte_ECU_ABS_h, category=SWHDR, domain=AUTOSAR}
        Rte_ECU_ABS_Type_h: artifact-descriptor={short-label=Rte_ECU_ABS_Type_h, category=SWHDR, domain=AUTOSAR}
        Rte_Hook_h: artifact-descriptor={short-label=Rte_Hook_h, category=SWHDR, domain=AUTOSAR}
        Rte_Intl_h: artifact-descriptor={short-label=Rte_Intl_h, category=SWHDR, domain=AUTOSAR}
        Rte_Lib_c: artifact-descriptor={short-label=Rte_Lib_c, category=SWSRC, domain=AUTOSAR}
        Rte_Main_h: artifact-descriptor={short-label=Rte_Main_h, category=SWHDR, domain=AUTOSAR}
        Rte_Rain_Sensor_c: artifact-descriptor={short-label=Rte_Rain_Sensor_c, category=SWSRC, domain=AUTOSAR}
        Rte_Rain_Sensor_h: artifact-descriptor={short-label=Rte_Rain_Sensor_h, category=SWHDR, domain=AUTOSAR}
        Rte_Rain_Sensor_Type_h: artifact-descriptor={short-label=Rte_Rain_Sensor_Type_h, category=SWHDR, domain=AUTOSAR}
        Rte_Switch_Sensor_c: artifact-descriptor={short-label=Rte_Switch_Sensor_c, category=SWSRC, domain=AUTOSAR}
        Rte_Switch_Sensor_h: artifact-descriptor={short-label=Rte_Switch_Sensor_h, category=SWHDR, domain=AUTOSAR}
        Rte_Switch_Sensor_Type_h: artifact-descriptor={short-label=Rte_Switch_Sensor_Type_h, category=SWHDR, domain=AUTOSAR}
        Rte_Type_h: artifact-descriptor={short-label=Rte_Type_h, category=SWHDR, domain=AUTOSAR}
        Rte_Wiper_Controller_c: artifact-descriptor={short-label=Rte_Wiper_Controller_c, category=SWSRC, domain=AUTOSAR}
        Rte_Wiper_Controller_h: artifact-descriptor={short-label=Rte_Wiper_Controller_h, category=SWHDR, domain=AUTOSAR}
        Rte_Wiper_Controller_Type_h: artifact-descriptor={short-label=Rte_Wiper_Controller_Type_h, category=SWHDR, domain=AUTOSAR}
        Rte_Wiper_Motor_c: artifact-descriptor={short-label=Rte_Wiper_Motor_c, category=SWSRC, domain=AUTOSAR}
        Rte_Wiper_Motor_h: artifact-descriptor={short-label=Rte_Wiper_Motor_h, category=SWHDR, domain=AUTOSAR}
        Rte_Wiper_Motor_Type_h: artifact-descriptor={short-label=Rte_Wiper_Motor_Type_h, category=SWHDR, domain=AUTOSAR}
        Switch_Sensor_MemMap_h: artifact-descriptor={short-label=Switch_Sensor_MemMap_h, category=SWHDR, domain=AUTOSAR}
        Wiper_Controller_MemMap_h: artifact-descriptor={short-label=Wiper_Controller_MemMap_h, category=SWHDR, domain=AUTOSAR}
        Wiper_Motor_MemMap_h: artifact-descriptor={short-label=Wiper_Motor_MemMap_h, category=SWHDR, domain=AUTOSAR}
    resource consumption ResConsumption
      5 x memory section:
        CODE: alignment=UNSPECIFIED, sw-addrmethod=CODE
        CONST_UNSPECIFIED: alignment=UNSPECIFIED, sw-addrmethod=CONST_UNSPECIFIED
        TASKBODY: alignment=UNSPECIFIED, sw-addrmethod=TASKBODY
        VAR_8BIT: alignment=8, sw-addrmethod=VAR_8BIT
        VAR_UNSPECIFIED: alignment=UNSPECIFIED, sw-addrmethod=VAR_UNSPECIFIED
package /AUTOSAR_Rte/DataConstrs
  range DataConstraints_DataConstr_uint8: phys 0..255, raw 0..255
package /AUTOSAR_Rte/ImplementationDataTypes
  18 x impl type:
    Rte_REActCounterType: category=VALUE  # This is an external type, i.e. it is declared in the Rte Library and not in the XML. RTEGen does not have any information about this type apart from its name.
    Rte_CDS_ECU_ABS: category=STRUCTURE
      element _dummy: implementation-data-type=uint8
    Rte_CDS_Rain_Sensor: category=STRUCTURE
      element _dummy: implementation-data-type=uint8
    Rte_CDS_Switch_Sensor: category=STRUCTURE
      element _dummy: implementation-data-type=uint8
    Rte_CDS_Wiper_Controller: category=STRUCTURE
      element _dummy: implementation-data-type=uint8
    Rte_CallFP_Wiper_Motor_CS_ECU_to_Actuator_CS_Oper_ECU_to_WiperMotor: category=FUNCTION_REFERENCE
    Rte_PDS_Wiper_Motor_CS_ECU_to_Actuator_R: category=STRUCTURE
      element Call_CS_Oper_ECU_to_WiperMotor: implementation-data-type=Rte_CallFP_Wiper_Motor_CS_ECU_to_Actuator_CS_Oper_ECU_to_WiperMotor
    Rte_PDS_Wiper_Motor_CS_ECU_to_Actuator_RA: category=ARRAY
      element Rte_PDS_Wiper_Motor_CS_ECU_to_Actuator_RAElement: array-size=1, array-size-semantics=FIXED-SIZE, implementation-data-type=Rte_PDS_Wiper_Motor_CS_ECU_to_Actuator_R
    Rte_ReadFP_Wiper_Motor_SR_App_to_Actuator_wipermotor_Speed_Value: category=FUNCTION_REFERENCE
    Rte_PDS_Wiper_Motor_SR_App_to_Actuator_R: category=STRUCTURE
      element Read_wipermotor_Speed_Value: implementation-data-type=Rte_ReadFP_Wiper_Motor_SR_App_to_Actuator_wipermotor_Speed_Value
    Rte_PDS_Wiper_Motor_SR_App_to_Actuator_RA: category=ARRAY
      element Rte_PDS_Wiper_Motor_SR_App_to_Actuator_RAElement: array-size=1, array-size-semantics=FIXED-SIZE, implementation-data-type=Rte_PDS_Wiper_Motor_SR_App_to_Actuator_R
    Rte_CDS_Wiper_Motor: category=STRUCTURE
      element Rport_ECU_to_WiperMotor: implementation-data-type=Rte_PDS_Wiper_Motor_CS_ECU_to_Actuator_RA
      element Rport_WiperController_to_WiperMotor: implementation-data-type=Rte_PDS_Wiper_Motor_SR_App_to_Actuator_RA
    Rte_SelfType_ECU_ABS: implementation-data-type=Rte_CDS_ECU_ABS
    Rte_SelfType_Rain_Sensor: implementation-data-type=Rte_CDS_Rain_Sensor
    Rte_SelfType_Switch_Sensor: implementation-data-type=Rte_CDS_Switch_Sensor
    Rte_SelfType_Wiper_Controller: implementation-data-type=Rte_CDS_Wiper_Controller
    Rte_SelfType_Wiper_Motor: implementation-data-type=Rte_CDS_Wiper_Motor
    Rte_TaskInfo: category=VALUE  # This is an external type, i.e. it is declared in the Rte Library and not in the XML. RTEGen does not have any information about this type apart from its name.
package /AUTOSAR_Rte/SwAddrMethods
  5 x sw addr method:
    CODE: section-type=CODE
    CONST_UNSPECIFIED: section-type=CONST
    TASKBODY: section-type=CODE
    VAR_8BIT: section-type=VAR
    VAR_UNSPECIFIED: section-type=VAR
